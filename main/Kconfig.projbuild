## main/Kconfig.projbuild
```kconfig
menu "ekami Digital Badge"
    help
        Configuration for the ekami digital badge

    menu "Font Options"
        config FONT12_EMBEDDED
            bool "Embed Font12 in firmware"
            default n

        config FONT16_EMBEDDED
            bool "Embed Font16 in firmware"
            default y

        config FONT18_EMBEDDED
            bool "Embed Font18 in firmware"
            default y

        config FONT24_EMBEDDED
            bool "Embed Font24 in firmware"
            default y

        config FONT28_EMBEDDED
            bool "Embed Font28 in firmware"
            default n

        config FONT36_EMBEDDED
            bool "Embed Font36 in firmware"
            default n

        config FONT48_EMBEDDED
            bool "Embed Font48 in firmware"
            default y

        config Auxiliary_Font_EMBEDDED
            bool "Embed Auxiliary Font in firmware"
            default n

        config FONT_ENABLE_TFCARD
            bool "Enable TF card font support"
            default y

        config FONT_ENABLE_SDCARD
            bool "Enable SD card font support (alias)"
            default y

        config FONT_DEBUG_ENABLED
            bool "Enable font debugging logs"
            default n
    endmenu

    menu "Image Resources"
        choice
            prompt "Image resource source"
            default IMG_SOURCE_EMBEDDED

            config IMG_SOURCE_EMBEDDED
                bool "Embedded images"

            config IMG_SOURCE_TFCARD
                bool "TF/SD card images"
        endchoice
    endmenu

endmenu
```

## sdkconfig.defaults
```kconfig
# Target
CONFIG_IDF_TARGET="esp32s3"

# Flash
CONFIG_ESPTOOLPY_FLASHSIZE_16MB=y
CONFIG_ESPTOOLPY_FLASHMODE_QIO=y

# PSRAM
CONFIG_SPIRAM=y
CONFIG_SPIRAM_MODE_OCT=y
CONFIG_SPIRAM_SPEED_80M=y

# Partition table
CONFIG_PARTITION_TABLE_CUSTOM=y
CONFIG_PARTITION_TABLE_CUSTOM_FILENAME="partitions.csv"

# WiFi
CONFIG_ESP_WIFI_SSID=""
CONFIG_ESP_WIFI_PASSWORD=""

# HTTP client
CONFIG_ESP_HTTP_CLIENT_ENABLE_HTTPS=y

# Logging
CONFIG_LOG_DEFAULT_LEVEL_INFO=y

# FreeRTOS
CONFIG_FREERTOS_HZ=1000

# Fonts - embed key sizes for the badge
CONFIG_FONT16_EMBEDDED=y
CONFIG_FONT18_EMBEDDED=y
CONFIG_FONT24_EMBEDDED=y
CONFIG_FONT48_EMBEDDED=y
CONFIG_FONT_ENABLE_TFCARD=y
CONFIG_FONT_ENABLE_SDCARD=y

# Images
CONFIG_IMG_SOURCE_EMBEDDED=y
```
